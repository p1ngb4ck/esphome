## esphome/components/emulator/emu/Kconfig
```kconfig
menu "emulator"

    config EMU_NES
        bool "NES"
        default n

    config EMU_GB
        bool "Game Boy / Color"
        default n

    config EMU_SMS
        bool "Master System / Game Gear / SG-1000 / ColecoVision"
        default n

    config EMU_PCE
        bool "PC Engine"
        default n

    config EMU_LYNX
        bool "Lynx"
        default n

    config EMU_SNES
        bool "Super Nintendo"
        default n

    config EMU_MD
        bool "Mega Drive / Genesis"
        default n

    config EMU_GW
        bool "Game & Watch"
        default n

    config EMU_MSX
        bool "MSX"
        default n

endmenu
```

## esphome/components/simple_video_player/emu/Kconfig
```kconfig
menu "svp emulator"

    config SVP_EMU_NES
        bool "NES"
        default n

    config SVP_EMU_GB
        bool "Game Boy / Color"
        default n

    config SVP_EMU_SMS
        bool "Master System / Game Gear / SG-1000 / ColecoVision"
        default n

    config SVP_EMU_PCE
        bool "PC Engine"
        default n

    config SVP_EMU_LYNX
        bool "Lynx"
        default n

    config SVP_EMU_SNES
        bool "Super Nintendo"
        default n

    config SVP_EMU_MD
        bool "Mega Drive / Genesis"
        default n

    config SVP_EMU_GW
        bool "Game & Watch"
        default n

endmenu
```
